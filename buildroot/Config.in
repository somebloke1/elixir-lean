## buildroot/Config.in
```kconfig
source "$BR2_EXTERNAL_MICROBEAM_PATH/package/beam-init/Config.in"
source "$BR2_EXTERNAL_MICROBEAM_PATH/package/microbeam-app/Config.in"
```

## buildroot/configs/microbeam_defconfig
```kconfig
# MicroBEAM Buildroot Configuration
# Minimal system for BEAM-as-init architecture

# Architecture
BR2_x86_64=y
BR2_x86_corei7=y

# Build options
BR2_CCACHE=y
BR2_OPTIMIZE_S=y
BR2_SHARED_STATIC_LIBS=y
BR2_GLOBAL_PATCH_DIR="$(BR2_EXTERNAL_MICROBEAM_PATH)/patches"

# Toolchain
BR2_TOOLCHAIN_BUILDROOT=y
BR2_TOOLCHAIN_BUILDROOT_MUSL=y
BR2_BINUTILS_VERSION_2_41_X=y
BR2_GCC_VERSION_13_X=y
BR2_TOOLCHAIN_BUILDROOT_CXX=y
BR2_GCC_ENABLE_LTO=y
BR2_USE_WCHAR=y
BR2_ENABLE_LOCALE=y

# Kernel
BR2_LINUX_KERNEL=y
BR2_LINUX_KERNEL_CUSTOM_VERSION=y
BR2_LINUX_KERNEL_CUSTOM_VERSION_VALUE="6.6.2"
BR2_LINUX_KERNEL_USE_CUSTOM_CONFIG=y
BR2_LINUX_KERNEL_CUSTOM_CONFIG_FILE="$(BR2_EXTERNAL_MICROBEAM_PATH)/kernel/microbeam.config"
BR2_LINUX_KERNEL_XZ=y

# System configuration
BR2_SYSTEM_DHCP=""
BR2_ROOTFS_DEVICE_CREATION_DYNAMIC_DEVTMPFS=y
BR2_TARGET_GENERIC_ROOT_PASSWD="microbeam"
BR2_SYSTEM_BIN_SH_NONE=y
BR2_INIT_NONE=y
BR2_ROOTFS_DEVICE_TABLE="$(BR2_EXTERNAL_MICROBEAM_PATH)/device_table.txt"
BR2_ROOTFS_OVERLAY="$(BR2_EXTERNAL_MICROBEAM_PATH)/rootfs_overlay"

# Required packages
BR2_PACKAGE_BUSYBOX=y
BR2_PACKAGE_BUSYBOX_CONFIG="$(BR2_EXTERNAL_MICROBEAM_PATH)/busybox-minimal.config"
BR2_PACKAGE_ERLANG=y
BR2_PACKAGE_ERLANG_MEGACO=n
BR2_PACKAGE_ERLANG_ELDAP=n
BR2_PACKAGE_ERLANG_DIAMETER=n
BR2_PACKAGE_ERLANG_X11=n
BR2_PACKAGE_ERLANG_WX=n
BR2_PACKAGE_ERLANG_OBSERVER=n
BR2_PACKAGE_ERLANG_DEBUGGER=n
BR2_PACKAGE_ERLANG_ET=n
BR2_PACKAGE_ERLANG_TFTP=n
BR2_PACKAGE_ERLANG_FTP=n
BR2_PACKAGE_ERLANG_JINTERFACE=n
BR2_PACKAGE_ERLANG_ODBC=n
BR2_PACKAGE_ERLANG_OS_MON=n
BR2_PACKAGE_ERLANG_COMMON_TEST=n
BR2_PACKAGE_ERLANG_DIALYZER=n
BR2_PACKAGE_ERLANG_ERL_DOCGEN=n
BR2_PACKAGE_ERLANG_EDOC=n
BR2_PACKAGE_ERLANG_ERL_INTERFACE=y
BR2_PACKAGE_ERLANG_ERTS=y
BR2_PACKAGE_ERLANG_INETS=n
BR2_PACKAGE_ERLANG_MNESIA=n
BR2_PACKAGE_ERLANG_PARSETOOLS=n
BR2_PACKAGE_ERLANG_RELTOOL=n
BR2_PACKAGE_ERLANG_RUNTIME_TOOLS=n
BR2_PACKAGE_ERLANG_SNMP=n
BR2_PACKAGE_ERLANG_SSH=n
BR2_PACKAGE_ERLANG_SYNTAX_TOOLS=n
BR2_PACKAGE_ERLANG_TOOLS=n
BR2_PACKAGE_ERLANG_XMERL=n
BR2_PACKAGE_ELIXIR=y
BR2_PACKAGE_OPENSSL=y
BR2_PACKAGE_ZLIB=y

# Custom packages
BR2_EXTERNAL=y
BR2_EXTERNAL_MICROBEAM_PATH="$(CONFIG_DIR)/.."
BR2_EXTERNAL_MICROBEAM_DESC="MicroBEAM packages"
BR2_PACKAGE_BEAM_INIT=y
BR2_PACKAGE_MICROBEAM_APP=y

# Filesystem
BR2_TARGET_ROOTFS_CPIO=y
BR2_TARGET_ROOTFS_CPIO_XZ=y
BR2_TARGET_ROOTFS_CPIO_UIMAGE=n

# Post-build scripts
BR2_ROOTFS_POST_BUILD_SCRIPT="$(BR2_EXTERNAL_MICROBEAM_PATH)/post-build.sh"
BR2_ROOTFS_POST_IMAGE_SCRIPT="$(BR2_EXTERNAL_MICROBEAM_PATH)/post-image.sh"

# Disable unneeded features
BR2_PACKAGE_BUSYBOX_SHOW_OTHERS=y
BR2_PACKAGE_IFUPDOWN_SCRIPTS=n
BR2_TARGET_ENABLE_ROOT_LOGIN=n
BR2_SYSTEM_BIN_SH=""
```

## buildroot/package/beam-init/Config.in
```kconfig
config BR2_PACKAGE_BEAM_INIT
	bool "beam-init"
	help
	  Minimal init process for MicroBEAM that launches BEAM as PID 1.

	  https://github.com/elixir-lean/microbeam
```

## buildroot/package/microbeam-app/Config.in
```kconfig
config BR2_PACKAGE_MICROBEAM_APP
	bool "microbeam-app"
	depends on BR2_PACKAGE_ERLANG
	depends on BR2_PACKAGE_ELIXIR
	select BR2_PACKAGE_OPENSSL
	help
	  MicroBEAM Elixir application - minimal HTTP server

	  https://github.com/elixir-lean/microbeam
```
